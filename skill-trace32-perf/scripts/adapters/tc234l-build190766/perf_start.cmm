; Arms SNOOPer only. It never executes Go, Break, WAIT, or target reset.
PRIVATE &binding &evidence &initial &capacity &current
ENTRY &binding &evidence &initial &capacity
GOSUB StateGate
IF VERSION.SOFTWARE()!="R.2026.02.000190766"||VERSION.BUILD()!=190766.||!CPUIS("TC234L")
    GOSUB RecoveryRequired
IF CHIP.EmulationDevice()||INTERFACE.NAME()!="PowerDebug PRO"
    GOSUB RecoveryRequired
IF VERSION.SERIAL.DEBUG()!="E17090031792"||VERSION.SERIAL.CABLE()!="C23090376246"
    GOSUB RecoveryRequired
IF LICENSE.FAMILY(0.)!="TriCore"||LICENSE.FEATURES(0.)!="'TriCore'"
    GOSUB RecoveryRequired
IF CORE.NUMBER()!=1.||CONFIGNUMBER()!=1.||CORE()!=0.
    GOSUB RecoveryRequired
IF !STATE.RUN()&&!STATE.HALT()
    GOSUB RecoveryRequired
IF SYStem.JtagClock()!=30000000.||!SYStem.Option.DUALPORT()
    GOSUB RecoveryRequired
IF (("&capacity"!="65536")&&("&capacity"!="32"))||SNOOPer.SIZE()!=&capacity||SNOOPer.STATE()!=0.
    GOSUB RecoveryRequired

GOSUB StateGate

ERROR.RESet
ON ERROR CONTinue
SNOOPer.Init
IF ERROR.OCCURRED()||SNOOPer.STATE()!=0.
(
    ON ERROR inherit
    GOSUB MutationFailure
)
SNOOPer.Arm
IF ERROR.OCCURRED()||SNOOPer.STATE()!=1.
(
    ON ERROR inherit
    GOSUB MutationFailure
)
ON ERROR inherit
OPEN #1 "&evidence" /Create
WRITE #1 "{""schema"":""t32perf.controller-start-evidence/v2"",""operation"":""perf_start"",""binding_sha256"":""&binding"",""initial_target_state"":""&initial"",""capture_armed"":true,""workload_owner"":""target_specific_controller"",""workload_identity"":""external-owner-sampling-window/v1""}"
CLOSE #1
PRINT "T32PERF_RESULT_BEGIN"
PRINT "{""protocol"":""t32perf/1"",""operation"":""perf_start"",""status"":""OK"",""code"":""started"",""binding_sha256"":""&binding""}"
PRINT "T32PERF_RESULT_END"
ENDDO

RecoveryRequired:
(
    GOSUB Recover
    ON ERROR inherit
    PRINT "T32PERF_MUTATION_RECOVERY_REQUIRED perf_start &binding"
    WHILE TRUE()
    (
        WAIT 1.s
    )
)
StateDrift:
(
    PRINT "T32PERF_RESULT_BEGIN"
    PRINT "{""protocol"":""t32perf/1"",""operation"":""perf_start"",""status"":""INVALID_ARGUMENT"",""code"":""initial_target_state_drift"",""binding_sha256"":""&binding"",""expected_initial_target_state"":""&initial"",""observed_target_state"":""&current""}"
    PRINT "T32PERF_RESULT_END"
    ENDDO
)
StateGate:
(
    &current="unavailable"
    IF STATE.RUN()
        &current="running"
    IF STATE.HALT()
        &current="halted"
    IF ("&initial"!="running"&&"&initial"!="halted")||"&current"!="&initial"
        GOSUB StateDrift
    RETURN
)
MutationFailure:
(
    GOSUB Recover
    ON ERROR inherit
    PRINT "T32PERF_MUTATION_RECOVERY_REQUIRED perf_start &binding"
    WHILE TRUE()
    (
        WAIT 1.s
    )
)
Recover:
(
    ERROR.RESet
    ON ERROR CONTinue
    SNOOPer.OFF
    SNOOPer.RESet
    SNOOPer.Mode PC
    SNOOPer.CORE 0.
    SNOOPer.Mode Stack
    SNOOPer.METHOD RealTime
    SNOOPer.SIZE 65536.
    SNOOPer.Rate 1.ms
    SNOOPer.Option.ERRORSTOP ON
    SNOOPer.Option.JITTER OFF
    SNOOPer.ZERO
    SNOOPer.AutoArm OFF
    SNOOPer.AutoInit OFF
    ON ERROR inherit
    RETURN
)
