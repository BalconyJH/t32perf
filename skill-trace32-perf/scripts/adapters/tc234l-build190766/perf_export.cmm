; Fixed PC sample export. Symbol is last because it may contain spaces.
PRIVATE &binding &output
ENTRY &binding &output
IF VERSION.SOFTWARE()!="R.2026.02.000190766"||VERSION.BUILD()!=190766.||!CPUIS("TC234L")
    GOSUB RecoveryRequired
IF CHIP.EmulationDevice()||INTERFACE.NAME()!="PowerDebug PRO"
    GOSUB RecoveryRequired
IF VERSION.SERIAL.DEBUG()!="E17090031792"||VERSION.SERIAL.CABLE()!="C23090376246"
    GOSUB RecoveryRequired
IF LICENSE.FAMILY(0.)!="TriCore"||LICENSE.FEATURES(0.)!="'TriCore'"
    GOSUB RecoveryRequired
IF CORE.NUMBER()!=1.||CONFIGNUMBER()!=1.||CORE()!=0.
    GOSUB RecoveryRequired
IF SYStem.JtagClock()!=30000000.||!SYStem.Option.DUALPORT()
    GOSUB RecoveryRequired
IF !STATE.RUN()&&!STATE.HALT()
    GOSUB RecoveryRequired
IF SNOOPer.STATE()!=0.||SNOOPer.RECORDS()==0.
    GOSUB RecoveryRequired
ERROR.RESet
ON ERROR CONTinue
SNOOPer.ZERO SNOOPer.FIRST()
IF ERROR.OCCURRED()
(
    ON ERROR inherit
    GOSUB MutationFailure
)
SNOOPer.EXPORT.Ascii "&output" Address CYcle %TimeFixed TIme.Zero sYmbol /ShowRecord
IF ERROR.OCCURRED()
(
    ON ERROR inherit
    GOSUB MutationFailure
)
ON ERROR inherit
PRINT "T32PERF_RESULT_BEGIN"
PRINT "{""protocol"":""t32perf/1"",""operation"":""perf_export"",""status"":""OK"",""code"":""raw_ascii_exported"",""binding_sha256"":""&binding""}"
PRINT "T32PERF_RESULT_END"
ENDDO

RecoveryRequired:
(
    GOSUB MutationFailure
)
MutationFailure:
(
    ERROR.RESet
    ON ERROR CONTinue
    SNOOPer.OFF
    SNOOPer.RESet
    SNOOPer.Mode PC
    SNOOPer.CORE 0.
    SNOOPer.Mode Stack
    SNOOPer.METHOD RealTime
    SNOOPer.SIZE 65536.
    SNOOPer.Rate 1.ms
    SNOOPer.Option.ERRORSTOP ON
    SNOOPer.Option.JITTER OFF
    SNOOPer.ZERO
    SNOOPer.AutoArm OFF
    SNOOPer.AutoInit OFF
    ON ERROR inherit
    PRINT "T32PERF_MUTATION_RECOVERY_REQUIRED perf_export &binding"
    WHILE TRUE()
    (
        WAIT 1.s
    )
)
