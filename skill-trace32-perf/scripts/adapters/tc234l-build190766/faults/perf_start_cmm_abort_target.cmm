; Deployment-only deterministic abort target. Never dispatched by public perf_start.
; The fixed wait begins only after SNOOPer Arm is verified. Official t32mcp abort
; is expected to interrupt this script; the recovery script then establishes the
; canonical adapter baseline and permanently closes the failed Session.
PRIVATE &binding &initial &capacity &current
ENTRY &binding &initial &capacity
GOSUB StateGate

IF VERSION.SOFTWARE()!="R.2026.02.000190766"||VERSION.BUILD()!=190766.||!CPUIS("TC234L")||CHIP.EmulationDevice()
    GOSUB RecoveryRequired
IF INTERFACE.NAME()!="PowerDebug PRO"||VERSION.SERIAL.DEBUG()!="E17090031792"||VERSION.SERIAL.CABLE()!="C23090376246"
    GOSUB RecoveryRequired
IF LICENSE.FAMILY(0.)!="TriCore"||LICENSE.FEATURES(0.)!="'TriCore'"
    GOSUB RecoveryRequired
IF CORE.NUMBER()!=1.||CONFIGNUMBER()!=1.||CORE()!=0.
    GOSUB RecoveryRequired
IF SYStem.JtagClock()!=30000000.||!SYStem.Option.DUALPORT()
    GOSUB RecoveryRequired
IF !STATE.RUN()&&!STATE.HALT()
    GOSUB RecoveryRequired
IF "&capacity"!="65536"||SNOOPer.SIZE()!=&capacity||SNOOPer.STATE()!=0.
    GOSUB RecoveryRequired
GOSUB StateGate

ERROR.RESet
ON ERROR CONTinue
SNOOPer.Init
SNOOPer.Arm
IF ERROR.OCCURRED()||SNOOPer.STATE()!=1.
(
    ON ERROR inherit
    GOSUB RecoverAndFail
)
ON ERROR inherit
PRINT "T32PERF_FAULT_ARMED cmm_abort perf_start &binding &initial"
WHILE TRUE()
(
    WAIT 1.s
)

StateDrift:
(
    PRINT "T32PERF_RESULT_BEGIN"
    PRINT "{""protocol"":""t32perf/1"",""operation"":""perf_start"",""status"":""INVALID_ARGUMENT"",""code"":""initial_target_state_drift"",""binding_sha256"":""&binding"",""expected_initial_target_state"":""&initial"",""observed_target_state"":""&current""}"
    PRINT "T32PERF_RESULT_END"
    ENDDO
)
StateGate:
(
    &current="unavailable"
    IF STATE.RUN()
        &current="running"
    IF STATE.HALT()
        &current="halted"
    IF ("&initial"!="running"&&"&initial"!="halted")||"&current"!="&initial"
        GOSUB StateDrift
    RETURN
)
RecoverAndFail:
(
    ERROR.RESet
    ON ERROR CONTinue
    SNOOPer.OFF
    SNOOPer.RESet
    SNOOPer.Mode PC
    SNOOPer.CORE 0.
    SNOOPer.Mode Stack
    SNOOPer.METHOD RealTime
    SNOOPer.SIZE 65536.
    SNOOPer.Rate 1.ms
    SNOOPer.Option.ERRORSTOP ON
    SNOOPer.Option.JITTER OFF
    SNOOPer.ZERO
    SNOOPer.AutoArm OFF
    SNOOPer.AutoInit OFF
    ON ERROR inherit
    PRINT "T32PERF_MUTATION_RECOVERY_REQUIRED perf_start &binding"
    WHILE TRUE()
    (
        WAIT 1.s
    )
)
RecoveryRequired:
(
    GOSUB RecoverAndFail
)
